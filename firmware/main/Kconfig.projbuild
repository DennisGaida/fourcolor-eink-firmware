## firmware/main/Kconfig.projbuild
```kconfig
menu "Xiaozhi Assistant"

config USE_EMOTE_MESSAGE_STYLE
    bool "Use rawdraw 1bpp rendering (no LVGL)"
    default y
    help
        When enabled, the display uses rawdraw 1bpp framebuffer rendering
        instead of LVGL. This is the recommended mode for the ZecTrix
        S3 E-Paper 4.2 board as LVGL causes frequent crashes.

config BOARD_TYPE_ZECTRIX_S3_EPAPER_4_2
    bool "zectrix-s3-epaper-4.2 FT firmware"
    default y
    depends on IDF_TARGET_ESP32S3
    help
        This local repository has been reduced to a single FT-only firmware
        for the zectrix-s3-epaper-4.2 board.

choice ZECTRIX_EPD_PANEL_TYPE
    prompt "ZecTrix EPD panel type"
    default ZECTRIX_EPD_PANEL_4COLOR_SSD2683
    depends on BOARD_TYPE_ZECTRIX_S3_EPAPER_4_2
    help
        Select the e-paper panel connected to the board. The 4-color option
        keeps the existing 1bpp UI framebuffer and converts it to the SSD2683
        2bpp wire format during refresh.

config ZECTRIX_EPD_PANEL_1BPP
    bool "1bpp black/white EPD"

config ZECTRIX_EPD_PANEL_4COLOR_SSD2683
    bool "4-color BWRY SSD2683 EPD"

endchoice

config ZECTRIX_EPD_4COLOR_BOOT_TEST_PATTERN
    bool "Show 4-color EPD test pattern at boot"
    default n
    depends on ZECTRIX_EPD_PANEL_4COLOR_SSD2683
    help
        Show black/white/red/yellow vertical bars once during display
        initialization so a newly connected 4-color panel can be verified.

config BUSY_LIGHT_DEBUG_CYCLE
    bool "Enable busy-light UP/DOWN debug status cycling"
    default n
    help
        When enabled, UP click cycles the busy-light default/detail face
        header through free/internal/leadership/customer, and DOWN click
        cycles through camera/presenting demo combinations - independent of
        the real calendar/presence bridge, so every tier and AV combination
        can be previewed without editing server data. Leave disabled for a
        real deployment: with it off, the header always reflects the real
        fetched presence status.

# These bake per-deployment values into the firmware image at build time
# (via sdkconfig, same mechanism as any other Kconfig option) instead of
# scattering them as raw constants across the source tree. sdkconfig is
# gitignored, so each checkout/dev machine can carry its own real values
# while sdkconfig.defaults.esp32s3 keeps a safe generic default for fresh
# checkouts. All of these were previously hand-editable constants in
# application.cc/i18n.cc - they still have the same effect, just declared
# in one place.
menu "Deployment defaults"

    config DEVICE_HOSTNAME
        string "Device network hostname"
        default "fourcolor-eink-display"
        help
            Hostname this device advertises on the network - set on the
            WiFi station netif via esp_netif_set_hostname() once the
            station interface is created (WifiStation::Start()), replacing
            ESP-IDF's own CONFIG_LWIP_LOCAL_HOSTNAME default ("espressif").
            Shows up as the DHCP client hostname on your router's device
            list. Must be a valid DNS label (letters, digits, hyphens; no
            spaces/underscores) - invalid values are left as ESP-IDF's
            "espressif" default rather than risking a broken DHCP request.

    config PRESENCE_BRIDGE_ENDPOINT
        string "Presence/calendar bridge base URL"
        default ""
        help
            Base URL (scheme + host, optionally :port, no trailing slash) of
            the server/calendar_bridge.py or server/presence_bridge.py
            instance this device polls for GET /live and GET
            /calendar/today. A real DNS hostname (e.g. an https:// domain
            behind a reverse proxy) works fine here - esp_http_client
            resolves it via the normal DNS resolver, this only needs to be
            a plain LAN IP if no public/LAN DNS entry exists for it.

            Leave empty to disable the busy-light module's presence fetch -
            it will just show no presence data. Set your own deployment's
            address locally (sdkconfig, gitignored) rather than committing
            a real address here.

    config WEATHER_API_KEY
        string "OpenWeatherMap API key"
        default ""
        help
            API key for https://openweathermap.org/api/one-call-3 (sign up
            at https://home.openweathermap.org/users/sign_up - One Call 3.0
            requires a payment method on file but includes a free monthly
            call allowance). Leave empty to disable the Weather module's
            live data fetch - the page will just show a "no weather data"
            placeholder.

            This ends up baked into your local sdkconfig (gitignored), same
            as any other Kconfig value - treat it like a deployment secret
            and never put a real key in sdkconfig.defaults.esp32s3 or here.

    config WEATHER_LOCATION
        string "Weather location (lat,lon decimal degrees)"
        default "53.5511,9.9937"
        help
            Passed as OpenWeatherMap One Call 3.0's `lat`/`lon` query
            parameters - must be "lat,lon" decimal-degree coordinates (a
            free-form city name is not accepted by this endpoint). Default
            is Hamburg, Germany. Look up coordinates for another location
            at https://openweathermap.org/find or any map service.

    choice WEATHER_UNITS
        prompt "Weather temperature unit"
        default WEATHER_UNITS_CELSIUS
        help
            Default/only temperature unit shown on the Weather page. No
            on-device toggle exists yet - this is build-time only.

        config WEATHER_UNITS_CELSIUS
            bool "Celsius (°C)"

        config WEATHER_UNITS_FAHRENHEIT
            bool "Fahrenheit (°F)"
    endchoice

    choice DEFAULT_UI_LANGUAGE
        prompt "Default UI language at first boot"
        default DEFAULT_UI_LANGUAGE_EN_US
        help
            Language shown before any Settings > Language toggle has been
            saved to NVS. Can still be changed on-device afterward - this
            only controls the very first boot's default.

        config DEFAULT_UI_LANGUAGE_EN_US
            bool "English (en-US)"

        config DEFAULT_UI_LANGUAGE_ZH_CN
            bool "Chinese (zh-CN)"
    endchoice

    choice DEFAULT_UI_MODULE
        prompt "Default module shown at boot"
        default DEFAULT_UI_MODULE_BUSY_LIGHT
        help
            Which page-selection-menu module the device opens to on boot.
            Only lists modules reachable via the normal quick-switch menu
            (BOOT click) - see RawDrawUiManager::GetQuickSwitchItems().

        config DEFAULT_UI_MODULE_BUSY_LIGHT
            bool "Busy light"

        config DEFAULT_UI_MODULE_WEATHER
            bool "Weather"

        config DEFAULT_UI_MODULE_GALLERY
            bool "Photo gallery"

        config DEFAULT_UI_MODULE_SETTINGS
            bool "Settings"
    endchoice

    config DEFAULT_SYNC_INTERVAL_MIN
        int "Default idle-nap sync interval (minutes, 0 disables)"
        default 30
        help
            How often the device wakes from deep sleep to resync when idle
            (ArmSyncSleepTimer/EnterScheduledSleep in application.cc). No
            Settings UI toggle exists for this yet, so it's build-time only
            for now. Set to 0 to disable this nap entirely (e.g. for a
            busy-light deployment relying only on quiet-hours sleep below).

    config DEFAULT_SLIDESHOW_INTERVAL_MIN
        int "Default gallery slideshow interval (minutes, 0 disables)"
        default 5
        help
            Must be one of 0, 5, 10, 30 - matches the cycle order of the
            Settings > Slideshow Interval toggle. Only affects first boot;
            changeable on-device afterward.

    config DEFAULT_LAN_SERVER_ENABLED
        bool "Default: LAN transfer HTTP server enabled"
        default n
        help
            Only affects first boot; changeable on-device afterward via
            Settings > LAN Server.

    config DEFAULT_QUIET_HOURS_ENABLED
        bool "Default: quiet-hours scheduled sleep enabled"
        default y
        help
            Only affects first boot; changeable on-device afterward via
            Settings > Quiet Hours.

    config QUIET_HOURS_WAKE_HOUR
        int "Quiet hours: daily wake hour (0-23, local time)"
        default 6
        range 0 23
        help
            Every day (including Sat/Sun), the device auto-wakes from
            quiet-hours deep sleep at this local hour:minute
            (see QUIET_HOURS_WAKE_MINUTE below). Applies uniformly on
            weekdays and weekends.

    config QUIET_HOURS_WAKE_MINUTE
        int "Quiet hours: daily wake minute (0-59)"
        default 0
        range 0 59

    config QUIET_HOURS_WEEKDAY_SLEEP_HOUR
        int "Quiet hours: Mon-Thu nightly sleep hour (0-23, local time)"
        default 19
        range 0 23
        help
            Monday-Thursday, quiet hours (and the deep sleep that goes with
            them) start at this local hour:minute and run until the daily
            wake time above.

    config QUIET_HOURS_WEEKDAY_SLEEP_MINUTE
        int "Quiet hours: Mon-Thu nightly sleep minute (0-59)"
        default 0
        range 0 59

    config QUIET_HOURS_FRIDAY_SLEEP_HOUR
        int "Quiet hours: Friday weekend sleep hour (0-23, local time)"
        default 18
        range 0 23
        help
            Friday quiet hours start earlier than other weeknights, and run
            through the whole weekend until Monday's daily wake time.

    config QUIET_HOURS_FRIDAY_SLEEP_MINUTE
        int "Quiet hours: Friday weekend sleep minute (0-59)"
        default 0
        range 0 59

    config QUIET_HOURS_GRACE_MINUTES
        int "Quiet hours: manual-wake grace period (minutes)"
        default 5
        range 1 60
        help
            After boot or any button press during quiet hours, the device
            stays awake for at least this long before quiet-hours sleep can
            trigger again (NoteQuietHoursActivity in application.cc) - so a
            manual BOOT wake isn't immediately re-slept.
endmenu

endmenu
```
